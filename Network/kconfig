## Network/kconfig
```kconfig
config NETWORK
    bool "Enable TCP/IP Network Support"
    default n
	
config TCP_WATCHDOG
    bool "Enable TCP Watchdog"
    select WATCHDOG
    depends on NETWORK
    default y
    help
    	reset watchdog timer on TCP/IP activity
  
config TCP_WATCHDOG_TIMEOUT
    int "TCP Watchdog Timeout"
    default 300
    depends on TCP_WATCHDOG
    help
    	TCP Watchdog timeout in seconds

config IP_ADDRESES_FROM_EEPROM
    bool "get IP addresses from EEPROM"
    depends on NETWORK
    default y
    help
    	Enable this option to get IP addresses from EEPROM
    	requires symbols (eeprom offset):
    	EEPROM_IP, EEPROM_IPMASK, EEPROM_GATEWAY, EEPROM_DNS, EEPROM_MAC

config TELNET_SERVER
    bool "Enable Telnet Server"
    depends on NETWORK
    default n
    help
    	Enable this option to enable Telnet server. It is up to the application
    	to provide the command line interface to the user.
    	
config HTTP_SERVER
    bool "Enable HTTP Server"
    depends on NETWORK
    default n

config HTTP_SERVER_INSTANCE
    bool "create a default HTTP Server Instance"
    depends on HTTP_SERVER
    default y
    help
    	Eneable this option to create a default HTTP Server Instance
    	Will provide a default set of servlets
    	If specific servlets are required, then this option should be disabled
    	httpServer::servletFactory() should be implemented
    	amd httpserver instance should be created manually

config SENSOR_STATE_SERVLET
    bool "Enable Sensor State Servlet"
    depends on HTTP_SERVER
    select SENSORS
    default 0
    help
    	enables a HTTP servlet to display sensor state /sensorState

config OUTPUT_CONTROL_SERVLET
    bool "Enable output control Servlet"
    depends on HTTP_SERVER
    help 
    	enables /outputState and /outputSet servlets 

config OUTPUT_CONTROL_SERVLET_USE_TLE8457_SERIAL
    bool "Enable setting output state using TLE8457 serial interface"
    depends on HTTP_SERVER
    depends on OUTPUT_CONTROL_SERVLET
    depends on TLE8457_COMM_LIB
    help 
    	/outputState and /outputSet servlets should use remote TLE8457 serial 
    	instead of local process control
    	if no dev param is provided, then the local process control is used
    	
config OUTPUT_CONTROL_SERVLET_TLE8457_SERIAL_TIMEOUT
    int "Timeout for requesting a state from a remote device [ms]"
    depends on HTTP_SERVER
    depends on OUTPUT_CONTROL_SERVLET
    depends on TLE8457_COMM_LIB
    depends on OUTPUT_CONTROL_SERVLET_USE_TLE8457_SERIAL
    default 5000
    	
   
```

## TLE8457_serial/kconfig
```kconfig
menuconfig TLE8457_COMM_LIB
    bool "Enable TLE8457 Communication Library"
    default y

choice TLE8457_SERIAL_PORT
	prompt "Choose serial port for communication" 
    depends on TLE8457_COMM_LIB
	default TLE8457_SERIAL_PORT_2

config TLE8457_SERIAL_PORT_1
        bool "Serial"

config TLE8457_SERIAL_PORT_2
        bool "Serial1"

config TLE8457_SERIAL_PORT_3
        bool "Serial2"

config TLE8457_SERIAL_PORT_4
        bool "Serial3"

endchoice

config COMMUNICATION_PAYLOAD_DATA_SIZE
    int "Communication Payload Data Size"
    default 20
    depends on TLE8457_COMM_LIB
    help
    	Frame Payload Data Size in bytes
 
config NUM_OF_RETRANSMISSIONS
    int "Number of obligatory Retransmissions"
    default 3
    depends on TLE8457_COMM_LIB
    help
    	Each frame will be retransmitted this number of times
    
 config MAX_NUM_OF_RETRANSMISSIONS
    int "Maximum Number of Retransmissions"
    default 5
    depends on TLE8457_COMM_LIB
    help
    	Maximum number of retransmissions in case of collisions 
    	before the frame is discarded
    	
config TRANSMISSION_SPEED
    int "Transmission Speed"
    default 115200
    depends on TLE8457_COMM_LIB
    help
    	Transmission Speed in bauds
    	
config MAX_TRANSMIT_DELAY
    int "Maximum Transmit Delay"
    default 100
    depends on TLE8457_COMM_LIB
    help
    	to avoid collisions, the frame will be transmitted with random delay
    	in range from 0 to this value in milliseconds
    	
config OUTPUT_QUEUE_SIZE
    int "Output Queue Size"
    default 3
    depends on TLE8457_COMM_LIB
    help
    	Number of frames that can be stored in the output queue
    	
```

## kconfig.inputprocess
```kconfig
menuconfig INPUT_PROCESS
    bool "Enable Input Process"
    default n
    help
       Enable the Input Process to control the digital input pins.

config INPUT_PROCESS_NUM_OF_PINS
    int "Number of input Pins"
    depends on INPUT_PROCESS
    range 1 16
    default 1

config INPUT_PROCESS_INSTANCE
    bool "instaniate Output Process"
    depends on INPUT_PROCESS
    default y
    
config INPUT_PROCESS_PIN0
    int "Input Pin 0"
    depends on INPUT_PROCESS
    depends on INPUT_PROCESS_NUM_OF_PINS > 0
    default 1

config INPUT_PROCESS_PIN1
    int "Input Pin 1"
    depends on INPUT_PROCESS
    depends on INPUT_PROCESS_NUM_OF_PINS > 1
    default 2
    
config INPUT_PROCESS_PIN2
    int "Input Pin 2"
    depends on INPUT_PROCESS
    depends on INPUT_PROCESS_NUM_OF_PINS > 2
    default 3

config INPUT_PROCESS_PIN3
    int "Input Pin 3"
    depends on INPUT_PROCESS
    depends on INPUT_PROCESS_NUM_OF_PINS > 3
    default 4
 
config INPUT_PROCESS_PIN4
    int "Input Pin 4"
    depends on INPUT_PROCESS
    depends on INPUT_PROCESS_NUM_OF_PINS > 4
    default 5
    
config INPUT_PROCESS_PIN5   
    int "Input Pin 5"
    depends on INPUT_PROCESS
    depends on INPUT_PROCESS_NUM_OF_PINS > 5
    default 6

config INPUT_PROCESS_PIN6
    int "Input Pin 6"
    depends on INPUT_PROCESS
    depends on INPUT_PROCESS_NUM_OF_PINS > 6
    default 7

config INPUT_PROCESS_PIN7
    int "Input Pin 7"
    depends on INPUT_PROCESS
    depends on INPUT_PROCESS_NUM_OF_PINS > 7
    default 8
 
config INPUT_PROCESS_PIN8
    int "Input Pin 8"
    depends on INPUT_PROCESS
    depends on INPUT_PROCESS_NUM_OF_PINS > 8
    default 9

config INPUT_PROCESS_PIN9
    int "Input Pin 9"
    depends on INPUT_PROCESS
    depends on INPUT_PROCESS_NUM_OF_PINS > 9
    default 10

config INPUT_PROCESS_PIN10
    int "Input Pin 10"
    depends on INPUT_PROCESS
    depends on INPUT_PROCESS_NUM_OF_PINS > 10
    default 11

config INPUT_PROCESS_PIN11
    int "Input Pin 11"
    depends on INPUT_PROCESS
    depends on INPUT_PROCESS_NUM_OF_PINS > 11
    default 12

config INPUT_PROCESS_PIN12
    int "Input Pin 12"
    depends on INPUT_PROCESS
    depends on INPUT_PROCESS_NUM_OF_PINS > 12
    default 13
    
config INPUT_PROCESS_PIN13
    int "Input Pin 13"
    depends on INPUT_PROCESS_INSTANCE
    depends on INPUT_PROCESS
    depends on INPUT_PROCESS_NUM_OF_PINS > 13
    default 14
 
config INPUT_PROCESS_PIN14
    int "Input Pin 14"
    depends on INPUT_PROCESS
    depends on INPUT_PROCESS_NUM_OF_PINS > 14
    default 15
  
config INPUT_PROCESS_PIN15
    int "Input Pin 15"
    depends on INPUT_PROCESS
    depends on INPUT_PROCESS_NUM_OF_PINS > 15
    default 16
  
config INPUT_PROCESS_PIN16
    int "Input Pin 16"
    depends on INPUT_PROCESS
    depends on INPUT_PROCESS_NUM_OF_PINS > 16
    default 17
  

config INPUT_PROCESS_PIN_ACTIVE_LOW0
    bool "Input Pin 0 active low"
    depends on INPUT_PROCESS_INSTANCE
    depends on INPUT_PROCESS
    depends on INPUT_PROCESS_NUM_OF_PINS > 0
    default y

config INPUT_PROCESS_PIN_ACTIVE_LOW1
    bool "Input Pin 1 active low"
    depends on INPUT_PROCESS_INSTANCE
    depends on INPUT_PROCESS
    depends on INPUT_PROCESS_NUM_OF_PINS > 1
    default y
    
config INPUT_PROCESS_PIN_ACTIVE_LOW2
    bool "Input Pin 2 active low"
    depends on INPUT_PROCESS_INSTANCE
    depends on INPUT_PROCESS
    depends on INPUT_PROCESS_NUM_OF_PINS > 2
    default y

config INPUT_PROCESS_PIN_ACTIVE_LOW3
    bool "Input Pin 3 active low"
    depends on INPUT_PROCESS_INSTANCE
    depends on INPUT_PROCESS
    depends on INPUT_PROCESS_NUM_OF_PINS > 3
    default y
 
config INPUT_PROCESS_PIN_ACTIVE_LOW4
    bool "Input Pin 4 active low"
    depends on INPUT_PROCESS_INSTANCE
    depends on INPUT_PROCESS
    depends on INPUT_PROCESS_NUM_OF_PINS > 4
    default y
    
config INPUT_PROCESS_PIN_ACTIVE_LOW5   
    bool "Input Pin 5 active low"
    depends on INPUT_PROCESS_INSTANCE
    depends on INPUT_PROCESS
    depends on INPUT_PROCESS_NUM_OF_PINS > 5
    default y

config INPUT_PROCESS_PIN_ACTIVE_LOW6
    bool "Input Pin 6 active low"
    depends on INPUT_PROCESS_INSTANCE
    depends on INPUT_PROCESS
    depends on INPUT_PROCESS_NUM_OF_PINS > 6
    default y

config INPUT_PROCESS_PIN_ACTIVE_LOW7
    bool "Input Pin 7 active low"
    depends on INPUT_PROCESS_INSTANCE
    depends on INPUT_PROCESS
    depends on INPUT_PROCESS_NUM_OF_PINS > 7
    default y
 
config INPUT_PROCESS_PIN_ACTIVE_LOW8
    bool "Input Pin 8 active low"
    depends on INPUT_PROCESS_INSTANCE
    depends on INPUT_PROCESS
    depends on INPUT_PROCESS_NUM_OF_PINS > 8
    default y

config INPUT_PROCESS_PIN_ACTIVE_LOW9
    bool "Input Pin 9 active low"
    depends on INPUT_PROCESS_INSTANCE
    depends on INPUT_PROCESS
    depends on INPUT_PROCESS_NUM_OF_PINS > 9
    default y

config INPUT_PROCESS_PIN_ACTIVE_LOW10
    bool "Input Pin 10 active low"
    depends on INPUT_PROCESS_INSTANCE
    depends on INPUT_PROCESS
    depends on INPUT_PROCESS_NUM_OF_PINS > 10
    default y

config INPUT_PROCESS_PIN_ACTIVE_LOW11
    bool "Input Pin 11 active low"
    depends on INPUT_PROCESS_INSTANCE
    depends on INPUT_PROCESS
    depends on INPUT_PROCESS_NUM_OF_PINS > 11
    default y

config INPUT_PROCESS_PIN_ACTIVE_LOW12
    bool "Input Pin 12 active low"
    depends on INPUT_PROCESS_INSTANCE
    depends on INPUT_PROCESS
    depends on INPUT_PROCESS_NUM_OF_PINS > 12
    default y
    
config INPUT_PROCESS_PIN_ACTIVE_LOW13
    bool "Input Pin 13 active low"
    depends on INPUT_PROCESS_INSTANCE
    depends on INPUT_PROCESS
    depends on INPUT_PROCESS_NUM_OF_PINS > 13
    default y
 
config INPUT_PROCESS_PIN_ACTIVE_LOW14
    bool "Input Pin 14 active low"
    depends on INPUT_PROCESS_INSTANCE
    depends on INPUT_PROCESS
    depends on INPUT_PROCESS_NUM_OF_PINS > 14
    default y
  
config INPUT_PROCESS_PIN_ACTIVE_LOW15
    bool "Input Pin 15 active low"
    depends on INPUT_PROCESS_INSTANCE
    depends on INPUT_PROCESS
    depends on INPUT_PROCESS_NUM_OF_PINS > 15
    default y
  
config INPUT_PROCESS_PIN_ACTIVE_LOW16
    bool "Input Pin 16 active low"
    depends on INPUT_PROCESS_INSTANCE
    depends on INPUT_PROCESS
    depends on INPUT_PROCESS_NUM_OF_PINS > 16
    default 17
  
 
```
