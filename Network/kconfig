## sensors/kconfig
```kconfig
menuconfig SENSORS_CONTROL_NODE
    bool "Enable Sensors Control Node"
    default n
    help
    	this enables the sensors control node, which is a node that 
    	can be used to control the sensors locally or from the remote
    	using telnet and web interface.
    	Default setings enable all control options, 
    	enabling HTTP/telnet enables the interface to control the 
		note! code not affected direclty by this opiton

config SENSORS_CONTROL_NODE_CONTROL_REMOTE_SENSORS
    bool "Enable Control node sending messages to contro remote nodes"
    depends on SENSORS_CONTROL_NODE
    depends on TLE8457_COMM_LIB
    select SENSORS_CONTROL_SENDER_OF_CONTOL_MESSAGES 
    default n
    help
    	Enable this option to allow the node to send control messages to the sensors
    	Enabling this option allows to control the sensors from the node
    	It modifies servlets and telnet commands to allow control of the remote 
    	by adding a prameter - a node the sensor is on
    	NOTE: at the moment telnet controls "remote"only

config TELNET_COMMANDS_SENSORS
    bool "Enable Telnet Commands for Sensors"
    depends on SENSORS_CONTROL_NODE
    depends on SENSORS_CONTROL_NODE_CONTROL_REMOTE_SENSORS
    depends on TELNET_SERVER
    default y
    help
    	Enable this option to provide commands for sensor values via Telnet
    	This provides basic commands to get sensor values
    
config TELNET_COMMANDS_SENSORS_REMOTE_CONTROL
    bool "Enable Telnet Commands for Remote Control of Sensors"
    depends on SENSORS_CONTROL_NODE
    depends on TELNET_COMMANDS_SENSORS
    default y
    help
    	Enable this option to provide commands to control sensor via Telnet
    	Provides commands to create, configure and start/stop sensors

config TELNET_COMMANDS_SENSORS_EEPROM_CONTROL
    bool "Enable Telnet Commands for EEPROM Control of Sensors"
    depends on SENSORS_CONTROL_NODE
    depends on TELNET_COMMANDS_SENSORS
    default y
    help
    	Enable this option to provide commands to store/read sensor configuration 
    	from EEPROM via Telnet

config HTTP_SEVLETS_SENSORS
    bool "Enable HTTP Servlets for Sensors"
    depends on SENSORS_CONTROL_NODE
    depends on HTTP_SERVER
    default y
    help
    	Enable this option to provide servlets for sensor values via HTTP
    	enables at the moment sensorStatem only

config SENSOR_STATE_SERVLET
    bool "Enable Sensor State Servlet"
    depends on SENSORS_CONTROL_NODE
    depends on SENSOR_HUB
    depends on HTTP_SEVLETS_SENSORS
    depends on SENSORS_JSON_OUTPUT
    default y
    help
    	enables a HTTP servlet to display sensor state /sensorState
    	
config SENSORS_CONTROL_SENDER_OF_CONTOL_MESSAGES
    bool 
    depends on TLE8457_COMM_LIB
    default n
    help 
    	hidden option, 
        used to enable the sender of control messages to the sensors




menuconfig SENSORS
    bool "Enable Sensors"
    default n
    help
    	enable the sensor subsystem. This shoud be enabled on a node
    	that run sensors
    	it is independent from sensor control
    	a node may be both - sensor runner and sensor controller 

config SENSORS_FACTORY
    bool "Enable Sensors Factory"
    depends on SENSORS
    default y
    
config SENSORS_FACTORY_INSTANCE
    bool "Create a default Sensors Factory Instance"
    depends on SENSORS_FACTORY
    default n
    help
      If this option is enabled, a default Sensors Factory Instance will be created.
      If this option is disabled, the Sensors Factory Instance mmay be extended or modified
      and must be created manually.
      Select Y if the app has no propertiary sensors
      Select N and override appSpecificCreateSensor otherwise

config SYSTEM_STATUS_SENSOR
    bool "Enable System Status Sensor"
    depends on SENSORS
    default y

config DS1820_SENSOR
    bool "Enable DS1820 Sensor"
    depends on SENSORS
    default n
    
config IMPULSE_SENSOR
    bool "Enable Impulse Sensor"
    depends on SENSORS
    default n
    
config OUTPUT_STATE_SENSOR
    bool "Enable Output State Sensor"
    depends on SENSORS
    depends on OUTPUT_PROCESS
    default n
    
config PT100_ANALOG_SENSOR
    bool "Enable PT100 termistor Sensor"
    depends on SENSORS
    default n
    
config WIEGAND_SENSOR  
    bool "Enable Wiegand Sensor"
    depends on SENSORS
    default n
    
config WIEGAND_D0_PIN
    int "pin to be used as D0" 
    default 2
    depends on SENSORS
    depends on WIEGAND_SENSOR
    
config WIEGAND_D1_PIN
    int "pin to be used as D1" 
    default 3
    depends on SENSORS
    depends on WIEGAND_SENSOR
    
config SIMPLE_DIGITAL_INPUT_SENSOR
    bool "Enable Simple Digital Input Sensor"
    depends on SENSORS
    default n

config SENSOR_SEND_EVENTS_USING_SERIAL
	bool "Enable sendng sensor events using serial communication"
	depends on TLE8457_COMM_LIB
	depends on SENSORS
	select SENSOR_BASIC_REMOTE_CONTROL
	help
		setting to be set on the node where sensors are running
		Enables sending sensor events to the central station
		Idivdual sensors will send events periodically depending on configuraion
		or on demand
       
config SENSORS_STORE_IN_EEPROM
	bool "Enable dynamic saving and restoring of all sensors to eeprom"
	default n 
    depends on SENSORS
	help
		to be used when sensors are dynamically created from the central node
		requires eeprom offsets: 
			EEPROM_NUM_OF_SENSORS, EEPROM_FIRST_SENSOR
		and EEPROM_SENSOR_STORAGE_SIZE to be defined
		
config SENSORS_RESTORE_FROM_EEPROM_AT_STARTUP
	bool "Enable restoring of sensors from eeprom at startup"
    default n
    depends on SENSORS_STORE_IN_EEPROM
    help
        restores sensors from eeprom at startup

choice SENSOR_EVENTS_TYPE
    prompt "Source of Sensor Events"
    depends on SENSORS || SENSOR_HUB
    default SENSOR_GENERATE_EVENTS if !SENSOR_HUB
    default SENSOR_HUB_GENERATE_EVENTS if SENSOR_HUB

config SENSOR_DONT_GENERATE_EVENTS
    depends on SENSORS || SENSOR_HUB
    bool "No local events generated by sensors"

config SENSOR_GENERATE_EVENTS
    depends on SENSORS || SENSOR_HUB
    bool "Enable Sensors Events, generated by tSensor class"
    
config SENSOR_HUB_GENERATE_EVENTS
	depends on SENSOR_HUB
    bool "Enable Sensors Events, generated by tSensorHub class"

endchoice


menuconfig SENSOR_HUB
    bool "Enable Sensor Hub"
    default n
    help
        Sensor Hub is a central controller for sensors. It can cache sensor data
        and handle messages from local or remote sensors
        usually this setting is enabled on the central controller

config SENSOR_HUB_FOR_REMOTE_SENSORS
    bool "Enable handling of messages from remote sensors and caching of sensor data in sensor hub"
    depends on SENSOR_HUB
    select TLE8457_COMM_LIB
    default n
    help
        This setting is enabling the sensor hub to cache sensor data
        and to handle messages from remote sensors
        usually this setting is enabled on the central controller
        when enabled sensor hub will handle messages:
        MESSAGE_TYPE_SENSOR_EVENT - a measure completed, thold exdeeded etc.
        MESSAGE_TYPE_GET_SENSOR_BY_ID_RESPONSE - handled as "sensor detected"

config SENSOR_HUB_AUTONAME_PREFIX
    string "prefix for detected sensors in sensor hub"
    depends on SENSOR_HUB
    default "Sensor_"
	help
	    When an unknown sensor is detected, it will be named as
	    prefix + sensor ID

config SENSOR_EVENTS_SERIAL_RECIEVER_ID
	int "Reciever ID of the sensor events"
	depends on SENSOR_SEND_EVENTS_USING_SERIAL
	default 1
	help
	    Reciever ID of the sensor events, sensor events will be sent to this ID 
	    Usually the ID of the central station

config SENSOR_BASIC_REMOTE_CONTROL
	bool "enables basic commands for remote control of sensors"
	depends on TELNET_SERVER
	depends on TLE8457_COMM_LIB
	help
        Enable this option to provide basic commands to control sensor via Telnet
        get sensor by id, get sensor value
        
config SENSOR_ADVANCED_REMOTE_CONTROL
	bool "Enable dynamic creation/deletion/start/stop of sensors using serial communication"
    select SENSOR_BASIC_REMOTE_CONTROL
	depends on TLE8457_COMM_LIB
	help
		setting to be set on the node where sensors are running
		this is independent from SENSOR_SEND_EVENTS_USING_SERIAL

config SENSORS_STORE_IN_EEPROM_REMOTE_CONTROL
    bool "Enable saving and restoring of all sensors to eeprom using serial communication"
    select SENSOR_BASIC_REMOTE_CONTROL
	depends on TLE8457_COMM_LIB
    help
    	allow on demand saving and restoring of all sensors to eeprom

config SENSORS_JSON_OUTPUT
    bool "Enable JSON output for sensors"
    depends on SENSOR_HUB
    default y
	help
		setting to be set on the central controller
		this settings is enabling translating binary format to JSON
		
config SENSORS_JSON_OUTPUT_INSTANCE
    bool "Enable JSON output for sensors instance"
    depends on SENSORS_JSON_OUTPUT
    default y
    help
        This setting enables JSON
        select Y if the app has no propertiary sensors 
        select N and override appSpecificGetSJONFrormatFunction otherwise

config SYSTEM_STATUS_SENSOR_JSON_OUTPUT
    bool "Enable System Status Sensor JSON output"
    depends on SENSORS_JSON_OUTPUT
    default y if SYSTEM_STATUS_SENSOR

config DS1820_SENSOR_JSON_OUTPUT
    bool "Enable DS1820 Sensor JSON output"
    depends on SENSORS_JSON_OUTPUT
    default y if DS1820_SENSOR
    
config IMPULSE_SENSOR_JSON_OUTPUT
    bool "Enable Impulse Sensor JSON output"
    depends on SENSORS_JSON_OUTPUT
    default y if IMPULSE_SENSOR
    
config OUTPUT_STATE_SENSOR_JSON_OUTPUT
    bool "Enable Output State Sensor JSON output"
    depends on SENSORS_JSON_OUTPUT
    default y if OUTPUT_STATE_SENSOR
    
config PT100_ANALOG_SENSOR_JSON_OUTPUT
    bool "Enable PT100 termistor Sensor JSON output"
    depends on SENSORS_JSON_OUTPUT
    default y if PT100_ANALOG_SENSOR
    
config WIEGAND_SENSOR_JSON_OUTPUT
    bool "Enable Wiegand Sensor JSON output"
    depends on SENSORS_JSON_OUTPUT
    default y if WIEGAND_SENSOR
    
config SIMPLE_DIGITAL_INPUT_SENSOR_JSON_OUTPUT
    bool "Enable Simple Digital Input Sensor JSON output"
    depends on SENSORS_JSON_OUTPUT
    default y if SIMPLE_DIGITAL_INPUT_SENSOR

config REMOTE_SENSORS_TEST
	bool "debug option, enable testing remote sensors on a single node"
	depends on SENSORS
	imply SENSOR_BASIC_REMOTE_CONTROL
	imply SENSOR_SEND_EVENTS_USING_SERIAL
	default n
	help
		this options enables testing remote sensors
		The system will handle all local sensors with ID > 1
		as if there were "remote", meaning:
		 - IDs > 1 won't generate local events, either directly nor through sensorhub
		 - IDs > 1 won't be registered in sensorHub locally
		the above allows testing communication with such sensors through serial communication only
		regardless they are running on the same node
```

## west.yml
```yaml
manifest:
  defaults:
    remote: szkudlik-homeAutomation

  remotes:
    - name: szkudlik-homeAutomation
      url-base: https://github.com/szkudlik-homeAutomation

  projects:
    - name: ds1820
      path: src/lib/ds1820
      repo-path: Arduino-Temperature-Control-Library
      revision: 7e57cf681b55229c672568d607101c4d25c44d73
      
    - name: ArduinoProcessScheduler    
      path: src/lib/ArduinoProcessScheduler
      repo-path: ArduinoProcessScheduler.git
      revision: 4d50a460d9fbabf550fe90f7084e12fd4ac0b45d

    - name: Ethernet
      path: src/lib/Ethernet
      repo-path: EthernetLib.git
      revision: 54eb50fb74d5e7d7ce6603c7d7b182c7e5a34a42

    - name: RingBuf
      path: src/lib/RingBuf
      repo-path: ArduinoRingBuffer.git
      revision: 4c3c648fedf5e43b0007fd27cdb3806c5be9e32d

    - name: AceCRC
      path: src/lib/AceCRC
      repo-path: AceCRC.git
      revision: fd967e3a15648ff7dc1ac8191733032314ceec23

    - name: Watchdog
      path: src/lib/Watchdog
      repo-path: Watchdog_lib.git
      revision: f8c11799f7d3b0283bbf330ddb4245c868f729e6
      
    - name: Commander
      path: src/lib/Commander
      repo-path: Commander_lib.git
      revision: 502c2b592338c044ba077a458518ffe74ddac6f1
      
    - name: ArduinoQueue
      path: src/lib/ArduinoQueue
      repo-path: ArduinoQueue_lib
      revision: ec430f73374464b30cc7f69dc5490eb86eff1dc9

    - name: OneWire
      path: src/lib/OneWire
      repo-path: OneWire_lib
      revision: 386a8d0715781fd38a61c7f0a753c2f988a2abca

    - name: Wiegand
      path: src/lib/Wiegand
      repo-path: Wiegand-Protocol-Library-for-Arduino.git
      revision: 66a1b619fac1d4de712c340f3cef4b2073b0e996
```
