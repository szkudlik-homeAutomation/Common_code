## kconfig.outputprocess
```kconfig
menuconfig OUTPUT_PROCESS
    bool "Enable Output Process"
    default n
    help
       Enable the Output Process to control the output pins.

config OUTPUT_PROCESS_NUM_OF_PINS
    int "Number of Output Pins"
    depends on OUTPUT_PROCESS
    range 1 16
    default 1

config OUTPUT_PROCESS_INSTANCE
    bool "instaniate Output Process"
    depends on OUTPUT_PROCESS
    default y
    
config OUTPUT_PROCESS_PIN0
    int "Physical pin for output 0"
    depends on OUTPUT_PROCESS
    depends on OUTPUT_PROCESS_NUM_OF_PINS > 0
    default 1
    help
    	set 255 to use pin as a virtual pin
    	with no physical pin assigned

config OUTPUT_PROCESS_PIN1
    int "Physical pin for output 1"
    depends on OUTPUT_PROCESS
    depends on OUTPUT_PROCESS_NUM_OF_PINS > 1
    default 2
    help
    	set 255 to use pin as a virtual pin
    	with no physical pin assigned
    
config OUTPUT_PROCESS_PIN2
    int "Physical pin for output 2"
    depends on OUTPUT_PROCESS
    depends on OUTPUT_PROCESS_NUM_OF_PINS > 2
    default 3
    help
    	set 255 to use pin as a virtual pin
    	with no physical pin assigned

config OUTPUT_PROCESS_PIN3
    int "Physical pin for output 3"
    depends on OUTPUT_PROCESS
    depends on OUTPUT_PROCESS_NUM_OF_PINS > 3
    default 4
    help
    	set 255 to use pin as a virtual pin
    	with no physical pin assigned
 
config OUTPUT_PROCESS_PIN4
    int "Physical pin for output 4"
    depends on OUTPUT_PROCESS
    depends on OUTPUT_PROCESS_NUM_OF_PINS > 4
    default 5
    help
    	set 255 to use pin as a virtual pin
    	with no physical pin assigned
    
config OUTPUT_PROCESS_PIN5   
    int "Physical pin for output 5"
    depends on OUTPUT_PROCESS
    depends on OUTPUT_PROCESS_NUM_OF_PINS > 5
    default 6
    help
    	set 255 to use pin as a virtual pin
    	with no physical pin assigned

config OUTPUT_PROCESS_PIN6
    int "Physical pin for output 6"
    depends on OUTPUT_PROCESS
    depends on OUTPUT_PROCESS_NUM_OF_PINS > 6
    default 7
    help
    	set 255 to use pin as a virtual pin
    	with no physical pin assigned

config OUTPUT_PROCESS_PIN7
    int "Physical pin for output 7"
    depends on OUTPUT_PROCESS
    depends on OUTPUT_PROCESS_NUM_OF_PINS > 7
    default 8
    help
    	set 255 to use pin as a virtual pin
    	with no physical pin assigned
 
config OUTPUT_PROCESS_PIN8
    int "Physical pin for output 8"
    depends on OUTPUT_PROCESS
    depends on OUTPUT_PROCESS_NUM_OF_PINS > 8
    default 9
    help
    	set 255 to use pin as a virtual pin
    	with no physical pin assigned

config OUTPUT_PROCESS_PIN9
    int "Physical pin for output 9"
    depends on OUTPUT_PROCESS
    depends on OUTPUT_PROCESS_NUM_OF_PINS > 9
    default 10
    help
    	set 255 to use pin as a virtual pin
    	with no physical pin assigned

config OUTPUT_PROCESS_PIN10
    int "Physical pin for output 10"
    depends on OUTPUT_PROCESS
    depends on OUTPUT_PROCESS_NUM_OF_PINS > 10
    default 11
    help
    	set 255 to use pin as a virtual pin
    	with no physical pin assigned

config OUTPUT_PROCESS_PIN11
    int "Physical pin for output 11"
    depends on OUTPUT_PROCESS
    depends on OUTPUT_PROCESS_NUM_OF_PINS > 11
    default 12
    help
    	set 255 to use pin as a virtual pin
    	with no physical pin assigned

config OUTPUT_PROCESS_PIN12
    int "Physical pin for output 12"
    depends on OUTPUT_PROCESS
    depends on OUTPUT_PROCESS_NUM_OF_PINS > 12
    default 13
    help
    	set 255 to use pin as a virtual pin
    	with no physical pin assigned
    
config OUTPUT_PROCESS_PIN13
    int "Physical pin for output 13"
    depends on OUTPUT_PROCESS
    depends on OUTPUT_PROCESS_NUM_OF_PINS > 13
    default 14
    help
    	set 255 to use pin as a virtual pin
    	with no physical pin assigned
 
config OUTPUT_PROCESS_PIN14
    int "Physical pin for output 14"
    depends on OUTPUT_PROCESS
    depends on OUTPUT_PROCESS_NUM_OF_PINS > 14
    default 15
    help
    	set 255 to use pin as a virtual pin
    	with no physical pin assigned
  
config OUTPUT_PROCESS_PIN15
    int "Physical pin for output 15"
    depends on OUTPUT_PROCESS
    depends on OUTPUT_PROCESS_NUM_OF_PINS > 15
    default 16
    help
    	set 255 to use pin as a virtual pin
    	with no physical pin assigned
  
config OUTPUT_PROCESS_PIN16
    int "Physical pin for output 16"
    depends on OUTPUT_PROCESS
    depends on OUTPUT_PROCESS_NUM_OF_PINS > 16
    default 17
    help
    	set 255 to use pin as a virtual pin
    	with no physical pin assigned
  

config OUTPUT_PROCESS_PIN_ACTIVE_LOW0
    bool "Output Pin 0 active low"
    depends on OUTPUT_PROCESS
    depends on OUTPUT_PROCESS_NUM_OF_PINS > 0
    default y

config OUTPUT_PROCESS_PIN_ACTIVE_LOW1
    bool "Output Pin 1 active low"
    depends on OUTPUT_PROCESS
    depends on OUTPUT_PROCESS_NUM_OF_PINS > 1
    default y
    
config OUTPUT_PROCESS_PIN_ACTIVE_LOW2
    bool "Output Pin 2 active low"
    depends on OUTPUT_PROCESS
    depends on OUTPUT_PROCESS_NUM_OF_PINS > 2
    default y

config OUTPUT_PROCESS_PIN_ACTIVE_LOW3
    bool "Output Pin 3 active low"
    depends on OUTPUT_PROCESS
    depends on OUTPUT_PROCESS_NUM_OF_PINS > 3
    default y
 
config OUTPUT_PROCESS_PIN_ACTIVE_LOW4
    bool "Output Pin 4 active low"
    depends on OUTPUT_PROCESS
    depends on OUTPUT_PROCESS_NUM_OF_PINS > 4
    default y
    
config OUTPUT_PROCESS_PIN_ACTIVE_LOW5   
    bool "Output Pin 5 active low"
    depends on OUTPUT_PROCESS
    depends on OUTPUT_PROCESS_NUM_OF_PINS > 5
    default y

config OUTPUT_PROCESS_PIN_ACTIVE_LOW6
    bool "Output Pin 6 active low"
    depends on OUTPUT_PROCESS
    depends on OUTPUT_PROCESS_NUM_OF_PINS > 6
    default y

config OUTPUT_PROCESS_PIN_ACTIVE_LOW7
    bool "Output Pin 7 active low"
    depends on OUTPUT_PROCESS
    depends on OUTPUT_PROCESS_NUM_OF_PINS > 7
    default y
 
config OUTPUT_PROCESS_PIN_ACTIVE_LOW8
    bool "Output Pin 8 active low"
    depends on OUTPUT_PROCESS
    depends on OUTPUT_PROCESS_NUM_OF_PINS > 8
    default y

config OUTPUT_PROCESS_PIN_ACTIVE_LOW9
    bool "Output Pin 9 active low"
    depends on OUTPUT_PROCESS
    depends on OUTPUT_PROCESS_NUM_OF_PINS > 9
    default y

config OUTPUT_PROCESS_PIN_ACTIVE_LOW10
    bool "Output Pin 10 active low"
    depends on OUTPUT_PROCESS
    depends on OUTPUT_PROCESS_NUM_OF_PINS > 10
    default y

config OUTPUT_PROCESS_PIN_ACTIVE_LOW11
    bool "Output Pin 11 active low"
    depends on OUTPUT_PROCESS
    depends on OUTPUT_PROCESS_NUM_OF_PINS > 11
    default y

config OUTPUT_PROCESS_PIN_ACTIVE_LOW12
    bool "Output Pin 12 active low"
    depends on OUTPUT_PROCESS
    depends on OUTPUT_PROCESS_NUM_OF_PINS > 12
    default y
    
config OUTPUT_PROCESS_PIN_ACTIVE_LOW13
    bool "Output Pin 13 active low"
    depends on OUTPUT_PROCESS
    depends on OUTPUT_PROCESS_NUM_OF_PINS > 13
    default y
 
config OUTPUT_PROCESS_PIN_ACTIVE_LOW14
    bool "Output Pin 14 active low"
    depends on OUTPUT_PROCESS
    depends on OUTPUT_PROCESS_NUM_OF_PINS > 14
    default y
  
config OUTPUT_PROCESS_PIN_ACTIVE_LOW15
    bool "Output Pin 15 active low"
    depends on OUTPUT_PROCESS
    depends on OUTPUT_PROCESS_NUM_OF_PINS > 15
    default y
  
config OUTPUT_PROCESS_PIN_ACTIVE_LOW16
    bool "Output Pin 16 active low"
    depends on OUTPUT_PROCESS
    depends on OUTPUT_PROCESS_NUM_OF_PINS > 16
    default 17
  
 
```
